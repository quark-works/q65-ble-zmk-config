## boards/q65-ble/Kconfig.defconfig
```kconfig
# Copyright (c) 2025 Brandon Beltran
# SPDX-License-Identifier: MIT

if BOARD_Q65BLE

config ZMK_KEYBOARD_NAME
    default "Q65-BLE"

config BT_CTLR
    default BT

endif # BOARD_Q65BLE
```

## boards/q65_ble/Kconfig.defconfig
```kconfig
# Copyright (c) 2025 Brandon Beltran
# SPDX-License-Identifier: MIT

if BOARD_Q65_BLE

config ZMK_KEYBOARD_NAME
    default "Q65_BLE"

config BT_CTLR
    default BT

endif # BOARD_Q65_BLE
```

## boards/q65_ble/Kconfig.q65_ble
```kconfig
# Copyright (c) 2025 Brandon Beltran
# SPDX-License-Identifier: MIT

config BOARD_Q65_BLE
    select SOC_NRF52840_QIAA
```
